## app_l6_task/drivers/our_driver/Kconfig
```kconfig
config OUR_DRIVER
    bool "Our Driver"
    default y
    help
        Enable the custom driver for this application.
```

## app_l6_task/dts/bindings/over_driver.yaml
```yaml
description: Our custom driver

compatible: "zephyr,our-driver"

include: base.yaml
```

## app_l7_task/drivers/our_driver/Kconfig
```kconfig
config OUR_DRIVER
    bool "Our Custom LED Sensor Driver"
    default n
    depends on GPIO
    depends on SENSOR
    help
        Enable the custom LED sensor driver.
```

## app_l7_task/lec7_task2/Kconfig
```kconfig
# Application-specific Kconfig
config APP_HEARTBEAT_PERIOD_MS
    int "Application heartbeat period in milliseconds"
    range 100 2000
    default 500

# Always include Zephyr's Kconfig
source "Kconfig.zephyr"

# Include driver Kconfig
rsource "../drivers/our_driver/Kconfig"
```

## tests/ring_buf/testcase.yaml
```yaml
common:
  tags:
    - unit
    - ring_buf
    - ztest
    - homework

tests:
  homework.unit.ring_buf:
    platform_allow: 
     - lpcxpresso55s16
     - qemu_cortex_m3
    timeout: 60
 
```
