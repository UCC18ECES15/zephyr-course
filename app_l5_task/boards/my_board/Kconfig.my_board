## app_l5_task/boards/my_board/Kconfig.my_board
```kconfig
config BOARD_MY_BOARD
	select SOC_LPC55S16 if BOARD_MY_BOARD
	select SOC_PART_NUMBER_LPC55S16JBD100
```

## app_l5_task/boards/my_board/board.yml
```yaml
board:
 name: my_board
 full_name: my_board
 vendor: iomico
 socs:
  - name: lpc55s16
```

## app_l5_task/boards/our_board/Kconfig.our_board
```kconfig
# Copyright (c) 2020 Henrik Brix Andersen <henrik@brixandersen.dk>
# Copyright 2024 NXP
#
# SPDX-License-Identifier: Apache-2.0

config BOARD_OUR_BOARD
	select SOC_LPC55S16 if BOARD_OUR_BOARD
	select SOC_PART_NUMBER_LPC55S16JBD100
```

## app_l5_task/boards/our_board/board.yml
```yaml
board:
  name: our_board
  full_name: our_board
  vendor: nxp
  socs:
    - name: lpc55s16
```
