## CMakeLists.txt
```
cmake_minimum_required(VERSION 3.20.0)


list(APPEND BOARD_ROOT ${CMAKE_CURRENT_SOURCE_DIR}/..)
find_package(Zephyr REQUIRED)
project(app2_hello_world)

target_sources(app PRIVATE src/main.c)
```

## Kconfig
```
# Always include board-specific config if needed
source "Kconfig.zephyr"
```

## prj.conf
```kconfig
#GPIO and Logging

CONFIG_PRINTK=y
CONFIG_CONSOLE=y
CONFIG_UART_CONSOLE=y
```

## src/main.c
```c
/*
 * Copyright (c) 2024
 * SPDX-License-Identifier: Apache-2.0
 */

#include <zephyr/kernel.h>
#include <zephyr/sys/printk.h>

int main(void)
{
	printk("Hello World! %s\n", CONFIG_BOARD);
	return 0;
}
```
