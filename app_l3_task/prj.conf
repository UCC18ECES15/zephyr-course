## Kconfig
```
# ------------------------------------------------------
# Top-level LED Subsystem (toggle)
# ------------------------------------------------------
menuconfig LED_SUBSYSTEM
    bool "Enable LED Subsystem"
    default y
    help
        Master toggle for all LED-related features.
        Disable to remove all LED configuration options.

if LED_SUBSYSTEM

# ------------------------------------------------------
# Blink Speed Selection (choice)
# ------------------------------------------------------
choice
    prompt "LED Blink Speed"
    default BLINK_SPEED_1000MS

config BLINK_SPEED_250MS
    bool "250 ms"

config BLINK_SPEED_500MS
    bool "500 ms"

config BLINK_SPEED_1000MS
    bool "1 second"

config BLINK_SPEED_2000MS
    bool "2 seconds"

endchoice

# ------------------------------------------------------
# Hidden int symbol to hold actual milliseconds
# ------------------------------------------------------
config BLINK_SLEEP_TIME_MS
    int
    default 250  if BLINK_SPEED_250MS
    default 500  if BLINK_SPEED_500MS
    default 1000 if BLINK_SPEED_1000MS
    default 2000 if BLINK_SPEED_2000MS
    help
        The actual sleep time in milliseconds derived
        from the selected blink speed.


# ------------------------------------------------------
# Advanced LED Settings (own menuconfig)
# ------------------------------------------------------
menuconfig LED_ADVANCED
    bool "Advanced LED Settings"
    help
        Extra LED parameters that can be configured.
        Disable to hide advanced settings.

if LED_ADVANCED

config LED_BRIGHTNESS
    int "LED brightness (0-100)"
    range 0 100
    default 100
    help
        Brightness range: 0 (off) to 100 (max).

config LED_FADE_DURATION
    int "LED fade duration (ms)"
    range 0 5000
    default 500
    help
        Fade duration in milliseconds.

# ------------------------------------------------------
# Expert settings (visible only if LED_ADVANCED is ON)
# ------------------------------------------------------
menu "Expert settings"

config LED_ENABLE_DEBUGGING
    bool "Enable LED debugging"
    default n
    help
        Enable debugging output for LED operations.

config LED_CUSTOM_BLINK_PATTERN
    bool "Custom blink pattern"
    default n
    help
        Enable custom blink pattern configuration.

if LED_CUSTOM_BLINK_PATTERN

config LED_PATTERN_ON_TIME
    int "Pattern ON time (ms)"
    range 50 5000
    default 200
    help
        Duration the LED stays ON in custom pattern.

config LED_PATTERN_OFF_TIME
    int "Pattern OFF time (ms)"
    range 50 5000
    default 800
    help
        Duration the LED stays OFF in custom pattern.

endif # LED_CUSTOM_BLINK_PATTERN

endmenu  # Expert settings

endif  # LED_ADVANCED

endif  # LED_SUBSYSTEM

# Always include board-specific config if needed
source "Kconfig.zephyr"
```

## prj.conf
```kconfig
CONFIG_GPIO=y
CONFIG_LOG=y
CONFIG_BLINK_SPEED_1000MS=y
CONFIG_LED_ENABLE_DEBUGGING=y

CONFIG_LOG_DEFAULT_LEVEL=3
CONFIG_LOG_MODE_IMMEDIATE=y

CONFIG_CONSOLE=y
CONFIG_UART_CONSOLE=y
CONFIG_LOG_BACKEND_UART=y

CONFIG_LED_ADVANCED=y
CONFIG_BLINK_SPEED_1000MS=y
```

## src/main.cpp
```c
#include <zephyr/drivers/gpio.h>
#include <zephyr/kernel.h>
#include <zephyr/logging/log.h>


/* The devicetree node identifier for the "led0" alias. */
#define LED_NODE DT_ALIAS(led0)

static const struct gpio_dt_spec led = GPIO_DT_SPEC_GET(LED_NODE, gpios);

LOG_MODULE_REGISTER(main, LOG_LEVEL_INF);

int main(void)
{
    bool led_state = true;

    if (!gpio_is_ready_dt(&led)) return 0;

    if (gpio_pin_configure_dt(&led, GPIO_OUTPUT_ACTIVE) < 0) return 0;

    #ifdef CONFIG_LED_ENABLE_DEBUGGING
        LOG_INF("LED Subsystem initialized");
        LOG_INF("Blink sleep time: %d ms", CONFIG_BLINK_SLEEP_TIME_MS);
        #ifdef CONFIG_LED_ADVANCED
        LOG_INF("LED Brightness: %d%%", CONFIG_LED_BRIGHTNESS);
        LOG_INF("LED Fade duration: %d ms", CONFIG_LED_FADE_DURATION);
        #endif
        #ifdef CONFIG_LED_CUSTOM_BLINK_PATTERN
        LOG_INF("Custom blink pattern enabled");
        LOG_INF("Pattern ON time: %d ms", CONFIG_LED_PATTERN_ON_TIME);
        LOG_INF("Pattern OFF time: %d ms", CONFIG_LED_PATTERN_OFF_TIME);
        #endif
    #endif

    while (1) {
        if (gpio_pin_toggle_dt(&led) < 0) return 0;

        led_state = !led_state;
    #ifdef CONFIG_LED_ENABLE_DEBUGGING
        LOG_INF("LED state: %s", led_state ? "ON" : "OFF");
    #endif
    #ifdef CONFIG_LED_CUSTOM_BLINK_PATTERN
        if (led_state) 
        {
            k_msleep(CONFIG_LED_PATTERN_ON_TIME);
        } 
        else 
        {
            k_msleep(CONFIG_LED_PATTERN_OFF_TIME);
        }
    #else
        k_msleep(CONFIG_BLINK_SLEEP_TIME_MS);
    #endif
    }
    return 0;
}
```
