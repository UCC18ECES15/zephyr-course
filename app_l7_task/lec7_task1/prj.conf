## CMakeLists.txt
```
cmake_minimum_required(VERSION 3.20.0)

find_package(Zephyr REQUIRED HINTS $ENV{ZEPHYR_BASE})
project(app_l7_task1)

# Add main source file
target_sources(app PRIVATE src/main.cpp)

# Add driver subdirectory
add_subdirectory(../drivers/our_driver ${CMAKE_CURRENT_BINARY_DIR}/our_driver)
```

## prj.conf
```kconfig
# Logging
CONFIG_LOG=y
CONFIG_LOG_MODE_IMMEDIATE=y

# Our driver
CONFIG_OUR_DRIVER=y

# GPIO
CONFIG_GPIO=y

# Sensor API
CONFIG_SENSOR=y

# Console and UART
CONFIG_CONSOLE=y
CONFIG_UART_CONSOLE=y
CONFIG_SERIAL=y

# Shell support - REQUIRED
CONFIG_SHELL=y
CONFIG_SHELL_BACKEND_SERIAL=y
CONFIG_SHELL_TAB=y
CONFIG_SHELL_TAB_AUTOCOMPLETION=y
CONFIG_SHELL_HISTORY=y
CONFIG_SHELL_HISTORY_BUFFER=512
CONFIG_SHELL_CMD_BUFF_SIZE=256
CONFIG_SHELL_PRINTF_BUFF_SIZE=256

# Enable built-in shell commands
CONFIG_KERNEL_SHELL=y
CONFIG_DEVICE_SHELL=y

# Increase stack sizes for shell
CONFIG_MAIN_STACK_SIZE=2048
CONFIG_SHELL_STACK_SIZE=2048
CONFIG_SYSTEM_WORKQUEUE_STACK_SIZE=2048

# Heap for shell
CONFIG_HEAP_MEM_POOL_SIZE=4096
```

## src/main.cpp
```c
#include <zephyr/kernel.h>
#include <zephyr/drivers/sensor.h>
#include <zephyr/logging/log.h>

extern "C" {
    #include "../../drivers/our_driver/our_driver.h"
}

LOG_MODULE_REGISTER(main, LOG_LEVEL_INF);

int main(void)
{
    LOG_INF("=== TASK 1: Sensor Shell Commands ===\n");
    
    const struct device* driver = DEVICE_DT_GET(DT_NODELABEL(our_driver0));
    
    if (!device_is_ready(driver)) {
        LOG_ERR("LED sensor driver not ready!");
        return -1;
    }
    
    LOG_INF("LED sensor driver is ready");
    LOG_INF("Shell is enabled. Available sensor commands:");
    LOG_INF("  - sensor fetch   : Call sensor_sample_fetch() - Turn LED ON");
    LOG_INF("  - sensor read    : Call sensor_channel_get() - Turn LED OFF");
    LOG_INF("  - sensor info    : Print device information\n");
    
    /* Main loop - shell runs in background */
    while (1) {
        k_sleep(K_SECONDS(10));
        LOG_INF("Main loop running... Use shell for interaction");
    }
    
    return 0;
}
```
